## dts/bindings/behaviors/kinesis,behavior-adv360-chatter.yaml
```yaml
# Copyright (c) 2026 The ZMK Contributors
# SPDX-License-Identifier: MIT

description: Kinesis Adv360 key chatter report (debug aid, see CONFIG_ZMK_ADV360_CHATTER_PROBE)

compatible: "kinesis,behavior-adv360-chatter"

include: zero_param.yaml
```
