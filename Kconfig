## Kconfig
```kconfig
# SPDX-License-Identifier: MIT

config ZMK_ADV360_STATUS_LEDS
    bool "Kinesis Adv360 status LEDs"
    default y
    depends on DT_HAS_KINESIS_ADV360_STATUS_LEDS_ENABLED
    select LED_STRIP
    select ZMK_EXT_POWER
    select ZMK_BATTERY_REPORTING
    select ZMK_HID_INDICATORS

if ZMK_ADV360_STATUS_LEDS

config ZMK_ADV360_STATUS_LEDS_ON_START
    bool "Turn Adv360 status LEDs on at startup"
    default y

config ZMK_ADV360_STATUS_LEDS_BRIGHTNESS_PERMILLE
    int "Adv360 status LED brightness in per mille (1/1000) of full scale"
    range 1 1000
    default 4
    help
      Every colour channel is multiplied by this value / 1000 (rounded down). The default of 4
      (= 1/250) matches the official Kinesis firmware, where a full 0xFF channel is output as 1.
      This replaces the former percent-based CONFIG_ZMK_ADV360_STATUS_LEDS_BRIGHTNESS (default 20).

config ZMK_ADV360_STATUS_LEDS_LOCK_COLOR
    hex "RGB hex colour of the Caps/Num/Scroll Lock LEDs"
    range 0x000000 0xFFFFFF
    default 0xFFFFFF

config ZMK_ADV360_STATUS_LEDS_EFF_START
    int "Effect the LEDs start in (0 solid, 1 breathe, 2 spectrum, 3 swirl, 4 status, 5 battery, 6 test)"
    range 0 6
    default 4

config ZMK_ADV360_STATUS_LEDS_HUE_START
    int "Start hue in degrees (solid, breathe, spectrum, swirl and test effects)"
    range 0 359
    default 0

config ZMK_ADV360_STATUS_LEDS_SAT_START
    int "Start saturation in percent"
    range 0 100
    default 100

config ZMK_ADV360_STATUS_LEDS_BRT_START
    int "Start brightness in percent"
    range ZMK_ADV360_STATUS_LEDS_BRT_MIN ZMK_ADV360_STATUS_LEDS_BRT_MAX
    default ZMK_ADV360_STATUS_LEDS_BRT_MAX

config ZMK_ADV360_STATUS_LEDS_SPD_START
    int "Start animation speed"
    range 1 5
    default 3

config ZMK_ADV360_STATUS_LEDS_HUE_STEP
    int "Hue step in degrees"
    range 0 359
    default 10

config ZMK_ADV360_STATUS_LEDS_SAT_STEP
    int "Saturation step in percent"
    range 0 100
    default 10

config ZMK_ADV360_STATUS_LEDS_BRT_STEP
    int "Brightness step in percent"
    range 0 100
    default 10

config ZMK_ADV360_STATUS_LEDS_BRT_MIN
    int "Minimum brightness in percent"
    range 0 100
    default 0

config ZMK_ADV360_STATUS_LEDS_BRT_MAX
    int "Maximum brightness in percent"
    range ZMK_ADV360_STATUS_LEDS_BRT_MIN 100
    default 100

config ZMK_ADV360_STATUS_LEDS_AUTO_OFF_IDLE
    bool "Turn the LEDs off when the keyboard goes idle"

config ZMK_ADV360_STATUS_LEDS_AUTO_OFF_USB
    bool "Turn the LEDs off when USB is disconnected"
    depends on USB_DEVICE_STACK

endif # ZMK_ADV360_STATUS_LEDS
```
